## main/Kconfig.projbuild
```kconfig
menu "Example Configuration"

    config ESP_WIFI_SSID
        string "WiFi SSID"
        default "myssid"
        help
            SSID (network name) for the example to connect to.

    config ESP_WIFI_PASSWORD
        string "WiFi Password"
        default "mypassword"
        help
            WiFi password (WPA or WPA2) for the example to use.

    choice ESP_WIFI_SAE_MODE
        prompt "WPA3 SAE mode selection"
        default ESP_WPA3_SAE_PWE_BOTH
        help
            Select mode for SAE as Hunt and Peck, H2E or both.
        config ESP_WPA3_SAE_PWE_HUNT_AND_PECK
            bool "HUNT AND PECK"
        config ESP_WPA3_SAE_PWE_HASH_TO_ELEMENT
            bool "H2E"
        config ESP_WPA3_SAE_PWE_BOTH
            bool "BOTH"
    endchoice

    config ESP_WIFI_PW_ID
        string "PASSWORD IDENTIFIER"
        depends on  ESP_WPA3_SAE_PWE_HASH_TO_ELEMENT|| ESP_WPA3_SAE_PWE_BOTH
        default ""
        help
            password identifier for SAE H2E

    config ESP_MAXIMUM_RETRY
        int "Maximum retry"
        default 5
        help
            Set the Maximum retry to avoid station reconnecting to the AP unlimited when the AP is really inexistent.

    choice ESP_WIFI_SCAN_AUTH_MODE_THRESHOLD
        prompt "WiFi Scan auth mode threshold"
        default ESP_WIFI_AUTH_WPA2_PSK
        help
            The weakest authmode to accept in the scan mode.
            This value defaults to ESP_WIFI_AUTH_WPA2_PSK incase password is present and ESP_WIFI_AUTH_OPEN is used.
            Please select ESP_WIFI_AUTH_WEP/ESP_WIFI_AUTH_WPA_PSK incase AP is operating in WEP/WPA mode.

        config ESP_WIFI_AUTH_OPEN
            bool "OPEN"
        config ESP_WIFI_AUTH_WEP
            bool "WEP"
        config ESP_WIFI_AUTH_WPA_PSK
            bool "WPA PSK"
        config ESP_WIFI_AUTH_WPA2_PSK
            bool "WPA2 PSK"
        config ESP_WIFI_AUTH_WPA_WPA2_PSK
            bool "WPA/WPA2 PSK"
        config ESP_WIFI_AUTH_WPA3_PSK
            bool "WPA3 PSK"
        config ESP_WIFI_AUTH_WPA2_WPA3_PSK
            bool "WPA2/WPA3 PSK"
        config ESP_WIFI_AUTH_WAPI_PSK
            bool "WAPI PSK"
    endchoice

    orsource "$IDF_PATH/examples/common_components/env_caps/$IDF_TARGET/Kconfig.env_caps"

    choice BLINK_LED
        prompt "Blink LED type"
        default BLINK_LED_GPIO if IDF_TARGET_ESP32 || IDF_TARGET_ESP32C2
        default BLINK_LED_STRIP
        help
            Select the LED type. A normal level controlled LED or an addressable LED strip.
            The default selection is based on the Espressif DevKit boards.
            You can change the default selection according to your board.

        config BLINK_LED_GPIO
            bool "GPIO"
        config BLINK_LED_STRIP
            bool "LED strip"
    endchoice

    choice BLINK_LED_STRIP_BACKEND
        depends on BLINK_LED_STRIP
        prompt "LED strip backend peripheral"
        default BLINK_LED_STRIP_BACKEND_RMT if SOC_RMT_SUPPORTED
        default BLINK_LED_STRIP_BACKEND_SPI
        help
            Select the backend peripheral to drive the LED strip.

        config BLINK_LED_STRIP_BACKEND_RMT
            depends on SOC_RMT_SUPPORTED
            bool "RMT"
        config BLINK_LED_STRIP_BACKEND_SPI
            bool "SPI"
    endchoice

    config BLINK_GPIO
        int "Blink GPIO number"
        range ENV_GPIO_RANGE_MIN ENV_GPIO_OUT_RANGE_MAX
        default 5 if IDF_TARGET_ESP32
        default 18 if IDF_TARGET_ESP32S2
        default 48 if IDF_TARGET_ESP32S3
        default 23 if IDF_TARGET_ESP32S6
        default 23
        help
            GPIO number (IOxx) to blink on and off the LED.
            Some GPIOs are used for other purposes (flash connections, etc.) and cannot be used to blink.

    config BLINK_PERIOD
        int "Blink period in ms"
        range 10 3600000
        default 1000
        help
            Define the blinking period in milliseconds.

    choice EXAMPLE_PROV_TRANSPORT
        bool "Provisioning Transport"
        default EXAMPLE_PROV_TRANSPORT_SOFTAP if IDF_TARGET_ESP32S2
        default EXAMPLE_PROV_TRANSPORT_BLE
        help
            Wi-Fi provisioning component offers both, SoftAP and BLE transports. Choose any one.

        config EXAMPLE_PROV_TRANSPORT_BLE
            bool "BLE"
            select BT_ENABLED
            depends on !IDF_TARGET_ESP32S2
        config EXAMPLE_PROV_TRANSPORT_SOFTAP
            bool "Soft AP"
            select LWIP_IPV4
    endchoice

    choice EXAMPLE_PROV_SECURITY_VERSION
        bool "Protocomm security version"
        default EXAMPLE_PROV_SECURITY_VERSION_2
        help
            Wi-Fi provisioning component offers 3 security versions.
            The example offers a choice between security version 1 and 2.

        config EXAMPLE_PROV_SECURITY_VERSION_1
            bool "Security version 1"
            select ESP_PROTOCOMM_SUPPORT_SECURITY_VERSION_1

        config EXAMPLE_PROV_SECURITY_VERSION_2
            bool "Security version 2"
            select ESP_PROTOCOMM_SUPPORT_SECURITY_VERSION_2
    endchoice

    choice EXAMPLE_PROV_MODE
        bool "Security version 2 mode"
        depends on EXAMPLE_PROV_SECURITY_VERSION_2
        default EXAMPLE_PROV_SEC2_DEV_MODE

        config EXAMPLE_PROV_SEC2_DEV_MODE
            bool "Security version 2 development mode"
            depends on EXAMPLE_PROV_SECURITY_VERSION_2
            help
                This enables the development mode for
                security version 2.
                Please note that this mode is NOT recommended for production purpose.

        config EXAMPLE_PROV_SEC2_PROD_MODE
            bool "Security version 2 production mode"
            depends on EXAMPLE_PROV_SECURITY_VERSION_2
            help
                This enables the production mode for
                security version 2.
    endchoice

    config EXAMPLE_PROV_TRANSPORT
        int
        default 1 if EXAMPLE_PROV_TRANSPORT_BLE
        default 2 if EXAMPLE_PROV_TRANSPORT_SOFTAP

    config EXAMPLE_PROV_ENABLE_APP_CALLBACK
        bool "Enable provisioning manager app callback"
        default n
        help
            This is for advanced use-cases like modifying Wi-Fi configuration parameters. This
            executes a blocking app callback when any provisioning event is triggered.

    config EXAMPLE_RESET_PROVISIONED
        bool
        default n
        prompt "Reset provisioned status of the device"
        help
            This erases the NVS to reset provisioned status of the device on every reboot.
            Provisioned status is determined by the Wi-Fi STA configuration, saved on the NVS.

    config EXAMPLE_RESET_PROV_MGR_ON_FAILURE
        bool
        default y
        prompt "Reset provisioned credentials and state machine after session failure"
        help
            Enable resetting provisioned credentials and state machine after session failure.
            This will restart the provisioning service after retries are exhausted.

    config EXAMPLE_PROV_MGR_CONNECTION_CNT
        int
        default 5
        prompt "Max connection attempts before resetting provisioning state machine"
        depends on EXAMPLE_RESET_PROV_MGR_ON_FAILURE
        help
            Set the total number of connection attempts to avoid reconnecting to an inexistent AP or if credentials
            are misconfigured. Provisioned credentials are erased and internal state machine
            is reset after this threshold is reached.

    config EXAMPLE_PROV_SHOW_QR
        bool "Show provisioning QR code"
        default y
        help
            Show the QR code for provisioning.

    config EXAMPLE_PROV_USING_BLUEDROID
        bool
        depends on (BT_BLUEDROID_ENABLED && (IDF_TARGET_ESP32C3 || IDF_TARGET_ESP32S3))
        select BT_BLE_42_FEATURES_SUPPORTED
        default y
        help
            This enables BLE 4.2 features for Bluedroid.

    config EXAMPLE_REPROVISIONING
        bool "Re-provisioning"
        help
            Enable re-provisioning - allow the device to provision for new credentials
            after previous successful provisioning.


endmenu
```

## sdkconfig.defaults
```kconfig
CONFIG_ESP_WIFI_SOFTAP_SUPPORT=n

# Override some defaults so BT stack is enabled and
CONFIG_BT_ENABLED=y
CONFIG_BTDM_CTRL_MODE_BLE_ONLY=y
CONFIG_BTDM_CTRL_MODE_BR_EDR_ONLY=n
CONFIG_BTDM_CTRL_MODE_BTDM=n
CONFIG_BT_NIMBLE_ENABLED=y

## For Bluedroid as binary is larger than default size
CONFIG_PARTITION_TABLE_CUSTOM=y
CONFIG_PARTITION_TABLE_CUSTOM_FILENAME="partitions.csv"
CONFIG_PARTITION_TABLE_FILENAME="partitions.csv"

# CONFIG_EXAMPLE_RESET_PROV_MGR_ON_FAILURE 1
# CONFIG_EXAMPLE_PROV_SECURITY_VERSION_2=y
# CONFIG_EXAMPLE_PROV_SEC2_DEV_MODE=y

#
# Example Configuration
#
CONFIG_EXAMPLE_PROV_TRANSPORT_BLE=y
# CONFIG_EXAMPLE_PROV_TRANSPORT_SOFTAP is not set
# CONFIG_EXAMPLE_PROV_SECURITY_VERSION_1 is not set
CONFIG_EXAMPLE_PROV_SECURITY_VERSION_2=y
CONFIG_EXAMPLE_PROV_SEC2_DEV_MODE=y
# CONFIG_EXAMPLE_PROV_SEC2_PROD_MODE is not set
CONFIG_EXAMPLE_PROV_TRANSPORT=1
# CONFIG_EXAMPLE_PROV_ENABLE_APP_CALLBACK is not set
# CONFIG_EXAMPLE_RESET_PROVISIONED is not set
CONFIG_EXAMPLE_RESET_PROV_MGR_ON_FAILURE=y
CONFIG_EXAMPLE_PROV_MGR_CONNECTION_CNT=5
CONFIG_EXAMPLE_PROV_SHOW_QR=y
# CONFIG_EXAMPLE_REPROVISIONING is not set
# end of Example Configuration
```
